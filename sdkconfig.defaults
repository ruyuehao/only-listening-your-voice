## sdkconfig.defaults
```kconfig
#
# ESP32-C3 声纹唤醒系统 — SDK 默认配置
#

# --- 目标芯片 ---
CONFIG_IDF_TARGET_ESP32C3=y

# --- 运行频率 ---
CONFIG_ESP32S3_DEFAULT_CPU_FREQ_160=y
CONFIG_ESP_DEFAULT_CPU_FREQ_MHZ=160

# --- 关闭 Wi-Fi / BLE（纯离线） ---
CONFIG_ESP_WIFI_ENABLED=n
CONFIG_BT_ENABLED=n

# --- I2S 使能 ---
CONFIG_I2S_ISR_IRAM_SAFE=y
CONFIG_I2S_SUPPRESS_DEPRECATE_WARN=y

# --- FreeRTOS ---
CONFIG_FREERTOS_HZ=1000
CONFIG_FREERTOS_UNICORE=n

# --- 分区表 ---
CONFIG_PARTITION_TABLE_CUSTOM=y
CONFIG_PARTITION_TABLE_CUSTOM_FILENAME="partitions.csv"
CONFIG_PARTITION_TABLE_OFFSET=0x8000

# --- Flash ---
CONFIG_ESPTOOLPY_FLASHSIZE_4MB=y
CONFIG_ESPTOOLPY_FLASHSIZE="4MB"

# --- 日志 ---
CONFIG_LOG_DEFAULT_LEVEL_INFO=y
CONFIG_LOG_MAXIMUM_LEVEL_INFO=y
CONFIG_BOOTLOADER_LOG_LEVEL_INFO=y

# --- 主任务栈 ---
CONFIG_ESP_MAIN_TASK_STACK_SIZE=4096

# --- 看门狗 ---
CONFIG_ESP_TASK_WDT_TIMEOUT_S=10
```
